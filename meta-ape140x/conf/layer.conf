## meta-ape140x/conf/layer.conf
```bitbake
# We have a conf and classes directory, add to BBPATH
BBPATH .= ":${LAYERDIR}"

# We have a recipes-* directories, add to BBFILES
BBFILES += "${LAYERDIR}/recipes-*/*/*.bb \
	${LAYERDIR}/recipes-*/*/*.bbappend"

BBFILE_COLLECTIONS += "ape140x"
BBFILE_PATTERN_ape140x = "^${LAYERDIR}/"
BBFILE_PRIORITY_ape140x = "6"
```

## meta-ape140x/conf/machine/ape140x.conf
```bitbake
#@TYPE: Machine
#@NAME: ape140x

#@DESCRIPTION: Machine configuration for ape140x systems


PREFERRED_PROVIDER_virtual/kernel ?= "linux-yocto-xenomai"
PREFERRED_VERSION_linux-yocto ?= "3.10%"

require conf/machine/include/tune-atom.inc

require conf/machine/include/x86-base.inc

MACHINE_FEATURES += "wifi efi pcbios"


XSERVER ?= "${XSERVER_X86_BASE} \
           ${XSERVER_X86_EXT} \
           ${XSERVER_X86_VESA} \
           "

MACHINE_EXTRA_RRECOMMENDS += "linux-firmware v86d eee-acpi-scripts"

EXTRA_OECONF_append_pn-matchbox-panel-2 = " --with-battery=acpi"

GLIBC_ADDONS = "nptl"

APPEND += "video=vesafb vga=0x318"
```

## meta-qemui386/conf/layer.conf
```bitbake
# We have a conf and classes directory, add to BBPATH
BBPATH .= ":${LAYERDIR}"

# We have a recipes-* directories, add to BBFILES
BBFILES += "${LAYERDIR}/recipes-*/*/*.bb \
	${LAYERDIR}/recipes-*/*/*.bbappend"

BBFILE_COLLECTIONS += "qemui386"
BBFILE_PATTERN_qemui386 = "^${LAYERDIR}/"
BBFILE_PRIORITY_qemui386 = "6"
```

## meta-qemui386/conf/machine/qemui386.conf
```bitbake
#@TYPE: Machine
#@NAME: qemui386

#@DESCRIPTION: Machine configuration for qemui386 systems


PREFERRED_PROVIDER_virtual/kernel ?= "linux-yocto-xenomai"
PREFERRED_VERSION_linux-yocto-xenomai ?= "3.10%"

PREFERRED_PROVIDER_virtual/xserver ?= "xserver-xorg"
PREFERRED_PROVIDER_virtual/libgl ?= "mesa"
PREFERRED_PROVIDER_virtual/libgles1 ?= "mesa"
PREFERRED_PROVIDER_virtual/libgles2 ?= "mesa"

require conf/machine/include/qemu.inc
require conf/machine/include/tune-i586.inc

MACHINE_FEATURES += "x86"
KERNEL_IMAGETYPE = "bzImage"
SERIAL_CONSOLE = "115200 ttyS0"
XSERVER = "xserver-xorg \
           ${@bb.utils.contains('DISTRO_FEATURES', 'opengl', 'mesa-driver-swrast', '', d)} \
           xf86-input-vmmouse \
           xf86-input-keyboard \
           xf86-input-evdev \
           xf86-video-vmware"
```

## meta-vmware/conf/layer.conf
```bitbake
# We have a conf and classes directory, add to BBPATH
BBPATH .= ":${LAYERDIR}"

# We have a recipes-* directories, add to BBFILES
BBFILES += "${LAYERDIR}/recipes-*/*/*.bb \
	${LAYERDIR}/recipes-*/*/*.bbappend"

BBFILE_COLLECTIONS += "vmware"
BBFILE_PATTERN_vmware = "^${LAYERDIR}/"
BBFILE_PRIORITY_vmware = "6"
```

## meta-vmware/conf/machine/vmware.conf
```bitbake
#@TYPE: Machine
#@NAME: vmware

#@DESCRIPTION: Machine configuration for vmware systems


PREFERRED_PROVIDER_virtual/kernel ?= "linux-yocto-xenomai"
PREFERRED_VERSION_linux-yocto ?= "3.10%"

require conf/machine/include/tune-i586.inc

require conf/machine/include/x86-base.inc

MACHINE_FEATURES += "wifi efi pcbios"


XSERVER ?= "${XSERVER_X86_BASE} \
           ${XSERVER_X86_EXT} \
           ${XSERVER_X86_VESA} \
           "

MACHINE_EXTRA_RRECOMMENDS += "linux-firmware v86d eee-acpi-scripts"

EXTRA_OECONF_append_pn-matchbox-panel-2 = " --with-battery=acpi"

GLIBC_ADDONS = "nptl"

APPEND += "video=vesafb vga=0x318"
```
